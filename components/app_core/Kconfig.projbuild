## components/app_core/Kconfig.projbuild
```kconfig
config DEMO_MISSING_PAGE
    bool "Hide weather page in demo fixture"
    default n
    help
        Remove the weather page from the deterministic demo registry.

config BATTERY_CALIBRATION_PERMILLE
    int "Battery divider calibration (permille of the nominal 3x divider)"
    default 1000
    help
        Real dividers run a few percent off nominal. 1000 applies no trim.

        With a multimeter: read the reported millivolts (Settings shows them),
        measure across the cell terminals with USB unplugged - charging holds
        the terminal voltage up - and set this to
        1000 * multimeter_mV / reported_mV.

        Without one, a fully charged cell is its own reference. A CC/CV charger
        terminates a single Li-ion cell at 4200 mV, to about a percent, so:
        leave the board on USB until the reported figure stops rising and holds
        steady for an hour or more, then set this to 4200000 / reported_mV.
        Confirm it really has plateaued before trusting it - a cell still
        charging is not at 4200 and would calibrate this the wrong way.

        The ADC itself already uses the chip's factory curve-fitting
        calibration, so this trims the divider ratio only, and the honest
        expectation is a couple of percent rather than precision. That is
        enough for the percentage; it matters most for the overvoltage
        thresholds, which a reading that is low by 3% would never reach.
```

## components/net_log/Kconfig.projbuild
```kconfig
config NET_LOG_ENABLE
    bool "Mirror logs to a LAN TCP port (net_log, diagnostic only)"
    default n
    help
        Streams every ESP_LOG line (in addition to serial, never instead
        of it) to a plaintext, unauthenticated TCP port on the LAN. This
        is a debugging aid for reaching the same information a USB serial
        capture would show, without a cable. Leave disabled unless
        actively diagnosing a problem: it widens who can see firmware log
        output from "someone with physical USB access" to "anyone on the
        LAN who connects to the port while it is running".

config NET_LOG_PORT
    int "net_log TCP port"
    default 3334
    depends on NET_LOG_ENABLE
    help
        Operators connect with: nc <device-ip> <port>

config NET_LOG_RING_BYTES
    int "net_log retained ring buffer size (bytes)"
    default 32768
    depends on NET_LOG_ENABLE
    help
        Recent log lines retained (allocated from PSRAM, not internal RAM)
        so an operator who connects after a failure still sees the lines
        that led up to it, not just whatever is logged from that point on.
```

## components/ota/Kconfig.projbuild
```kconfig
config OTA_RELEASE_REPO
    string "GitHub repository to check for firmware releases"
    default "a9650615/esp32-rlcd-standalone"
    help
        "owner/name" of the repository whose latest release is offered as a
        firmware update on the settings page. Change this if you forked the
        project, or the device will offer you someone else's builds.

        The check is read-only and never installs on its own: it reports what
        it found and leaves the decision on the settings page.

        Unauthenticated GitHub API requests are rate-limited per source
        address (60/hour at the time of writing), which is ample for a check
        driven by a button press.

config OTA_RELEASE_ASSET_SUFFIX
    string "Filename suffix identifying the firmware asset in a release"
    default ".bin"
    help
        A release can carry several attachments. The first asset whose name
        ends with this suffix is treated as the firmware image.

        Note that a wrong choice here is not dangerous: whatever is downloaded
        still has to pass the image header check before a single byte of the
        OTA slot is erased.

config OTA_ALLOW_UNCONFIRMED_PUSH
    bool "Install pushed firmware without asking at the board (development)"
    default n
    help
        Skips the on-screen confirmation for POST /ota, so a push installs
        immediately.

        This exists because the confirmation costs a walk to the board on
        every single iteration, and on a device being developed over the
        network that is the slowest step in the loop by a wide margin.

        Understand exactly what it removes. The upload endpoint listens
        whenever the board is on the network and is not password-gated - the
        button press IS the authorisation. With this on, anyone who can reach
        the board's upload port can replace its firmware with no interaction
        at all. That is acceptable on a development desk and is not acceptable
        anywhere else.

        Two things keep it from escaping. It defaults to n, and it is
        additionally compiled out whenever NDEBUG is defined, so a release
        build has no bypass regardless of what this is set to. A board built
        with it on says so in its log at every boot and on the panel while it
        installs.
```

## modules/airplay/Kconfig.projbuild
```kconfig
config AIRPLAY_ENABLE
    bool "Enable AirPlay (RAOP) receiver"
    default n
    help
        Vendors an AirPlay 1 (RAOP) receiver (esp-raop-receiver, from
        codeberg.org/Edu_Coder/esp-airsync - see modules/airplay/UPSTREAM.md)
        plus Apple's own open-source ALAC decoder, in place of upstream's
        prebuilt libalac.a. Wired into main/app_main.cpp (a non-fatal
        airplay_init() call, same pattern as audio_init()), feeds decoded
        PCM into modules/audio's streaming sink for the session's lifetime,
        registers its own tray indicator, and disables Wi-Fi power save
        while a session is open. Defaults off, and unlike audio's "cheap
        and harmless when idle" default-on, this has real costs even before
        anyone streams to it:

        - The RSA key AirPlay 1's handshake needs (Apple's AirPort Express
          private key) is not shipped in this repository and never will be
          - turning this on without supplying your own copy at
          modules/airplay/secrets/raop_private_key.pem (gitignored) fails
          the build with an explanatory message. See README.md, "The RSA
          key situation".
        - AirPlay needs Wi-Fi power save disabled and sustained CPU for the
          RTSP/RTP/ALAC/mDNS work, which this board's battery-drain
          tracking makes a real, measured cost, not a hypothetical one -
          see README.md, "Power".
        - Roughly 86KiB of flash and, once a client actually connects,
          about 1.3MB of PSRAM for the RTP jitter buffer and decoded-PCM
          ring (see README.md, "Buffer sizing" and "What is unverified").

        Turning this on proves the receiver, ALAC decoder, and the wiring
        into modules/audio/the tray/Wi-Fi power save all compile and link;
        it does not prove a real handshake or a real client connects - see
        README.md for exactly what is and is not verified.
```

## modules/audio/Kconfig.projbuild
```kconfig
config AUDIO_ENABLE
    bool "Enable onboard audio (ES8311 codec + speaker test tone)"
    default y
    help
        Stage 1 of audio support: initializes the ES8311 codec and its I2S
        TX path at startup, and backs the debug-only POST /beep route with
        a short test tone. A beep/alarm capability is a legitimate native
        feature, so this defaults on - but audio is still an optional
        module, not part of the native firmware: the display, clock,
        sensors, battery, portal, and OTA all build and behave identically
        with this on or off.

        Turning this off removes the ES8311/I2S code and the
        espressif/esp_codec_dev managed dependency from the build entirely
        - audio_init() and audio_play_tone() become inline no-ops (see
        audio.hpp) rather than a runtime check, so none of this component
        ends up in the binary.
```
